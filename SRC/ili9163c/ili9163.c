#include "main.h"
#include "ili9163.h"

char ILI9163_Str_BUF[200]; //发送缓冲,最大200字节，不能太小，如果你的内容太长会访问非法内存
uint16_t spi_data;

static void TFTSPI_Addr_Rst(void)
{
  send_command(0x2a);     //配置MCU可操作的LCD内部RAM横坐标起始、结束参数
	send_byte(0x00, DATA);      //横坐标起始地址0x0000
  send_byte(0x00, DATA);					
  send_byte(0x00, DATA);       //横坐标结束地址0x007f(127)
  send_byte(0xa8, DATA);       //7f  
  send_command(0x2b);     //配置MCU可操作的LCD内部RAM纵坐标起始结束参数
  send_byte(0x00, DATA);       //纵坐标起始地址0x0000
  send_byte(0x00, DATA);
  send_byte(0x00, DATA);       //纵坐标结束地址0x009f(159)
  send_byte(0xb3, DATA);       //9f  
  send_command(0x2C);     //GRAM接收MCU数据或命令
}

/*!
* @brief    全屏显示单色画面
*
* @param    color ：填充的颜色
*
* @return   无
*
* @note     起始、终止横坐标(0-127)，纵坐标(0-159),显示颜色uint16
*
* @see      TFTSPI_CLS(u16YELLOW);
*
* @date     2019/6/13 星期四
*/
void ili9163_clr(unsigned short color)
{
  unsigned int i,j;
  
  TFTSPI_Addr_Rst();
  
  for(i=0;i<TFT_VER_RES;i++)      //160
  {
    for(j=0;j<TFT_HOR_RES;j++)
    {
      send_word(color, DATA);
    }
  }
}
//static void tft_flush(lv_disp_drv_t *data_regv, const lv_area_t *area, lv_color_t *color_p)
//{
//    /*Return if the area is out the screen*/
//    if(area->x2 < 0) return;
//    if(area->y2 < 0) return;
//    if(area->x1 > TFT_HOR_RES - 1) return;
//    if(area->y1 > TFT_VER_RES - 1) return;

//    uint32_t x=0, y=0;
//	
//    HAL_GPIO_WritePin(CSPin_GPIO_Port, CSPin_Pin, GPIO_PIN_RESET);
//    SetAddata_regessWindow(area->x1, area->y1, area->x2, area->y2);
//    for(y=area->y1;y<=area->y2;y++)
//    {
//        for(x=area->x1;x<=area->x2;x++)
//        {
//            uint8_t data[] = { color_p->full >> 8, color_p->full & 0xFF };
//            send_data(data, sizeof(data));
//            color_p++;
//        }
//    }
//    HAL_GPIO_WritePin(CSPin_GPIO_Port, CSPin_Pin, GPIO_PIN_SET);

//    lv_disp_flush_ready(disp);
//}

void SetAddata_regessWindow(uint8_t x0, uint8_t y0, uint8_t x1, uint8_t y1) 
{
    // column addata_regess set
    send_command(0x2A);
    uint8_t data[] = { 0x00, x0 + 0, 0x00, x1 + 0 };
    send_data(data, sizeof(data));

    // row addata_regess set
    send_command(0x2B);
    data[1] = y0 + 0;
    data[3] = y1 + 0;
    send_data(data, sizeof(data));

    // write to RAM
    send_command(0x2C);
}

/* 10 FPS */
void ili9163_init(void)
{
//	HAL_GPIO_WritePin(BL_Pin_GPIO_Port, BL_Pin_Pin, GPIO_PIN_SET);
	HAL_GPIO_WritePin(ResPin_GPIO_Port, ResPin_Pin, GPIO_PIN_SET);
	HAL_Delay(10);
	HAL_GPIO_WritePin(ResPin_GPIO_Port, ResPin_Pin, GPIO_PIN_RESET);
	HAL_Delay(10);
	HAL_GPIO_WritePin(ResPin_GPIO_Port, ResPin_Pin, GPIO_PIN_SET);
	HAL_Delay(10);
	HAL_GPIO_WritePin(CSPin_GPIO_Port, CSPin_Pin, GPIO_PIN_RESET);

	send_byte(0x01, REG); //Software reset
	HAL_Delay(10);
	send_byte(0x11, REG); //Exit Sleep
	HAL_Delay(120);

	send_byte(0x26, REG); //Set default gamma
	send_byte(0x04, DATA);

	send_byte(0xB1, REG); //Set Frame Rate //Frame Rate Control (In normal mode/Full colors)
	send_byte(0x08, DATA); // DIVA = 8
	send_byte(0x09, DATA); // VPA = 9

	send_byte(0xC0, REG); //Set Power Control 1
	send_byte(0x1F, DATA);
	// send_byte(0x04, DATA); // retirado na versao do Github

	send_byte(0xC1, REG); //Set Power Control 2
	send_byte(0x02, DATA);
	//AVDD: 2xVCI1
	//VCL: -VCI1
	//VGH: 5xVCI1
	//VGL: 5xVCI1
	//VGH-VGL<=32v!

	send_byte(0xC2, REG); //Set Power Control 3
	send_byte(0x00, DATA);
	send_byte(0x07, DATA);

	send_byte(0xC3, REG); //Set Power Control 4 (Idle mode)
	send_byte(0x00, DATA);
	send_byte(0x07, DATA);

	send_byte(0xC5, REG); //Set VCom Control 1
	send_byte(0x24, DATA); // VComH = 3v
	send_byte(0xC8, DATA); // VComL = 0v

	send_byte(0x36, REG); //Set Memory access mode
//	send_byte(0x08, DATA); //竖屏1
	send_byte(0xC0, DATA);	//竖屏2
//	send_byte(0xA8, DATA);	//横屏1
//	send_byte(0x68, DATA);	//横屏2
	
	// RotateScreen(DEG180, 0);

	send_byte(0x13, REG); //Normal mode on

	send_byte(0x3A, REG); //Set pixel mode
	send_byte(0x05, DATA);

	send_byte(0x29, REG); //Display on

	// send_byte(0x2C, REG); //Memory Write 

	// InvMode(0);
	// ClrScrn();
}

void send_byte(uint8_t data, uint8_t data_reg)
{
	spi_data = data;
	if (data_reg == DATA) {
		HAL_GPIO_WritePin(AOPin_GPIO_Port, AOPin_Pin, GPIO_PIN_SET);
	} else{
		HAL_GPIO_WritePin(AOPin_GPIO_Port, AOPin_Pin, GPIO_PIN_RESET);
	}
	HAL_SPI_Transmit(HSPI, (uint8_t *)&spi_data, (uint16_t)1, HAL_MAX_DELAY);
}

void send_data(uint8_t *data, uint8_t data_len)
{
	HAL_GPIO_WritePin(AOPin_GPIO_Port, AOPin_Pin, GPIO_PIN_SET);
	HAL_SPI_Transmit(HSPI, (uint8_t *)data, (uint16_t)data_len, HAL_MAX_DELAY);
//	HAL_SPI_Transmit_DMA(HSPI, (uint8_t *)data, (uint16_t)data_len);
}

void send_command(uint8_t data)
{
	uint8_t cmd = data;
	HAL_GPIO_WritePin(AOPin_GPIO_Port, AOPin_Pin, GPIO_PIN_RESET);
	HAL_SPI_Transmit(HSPI, (uint8_t *)&cmd, (uint16_t)1, HAL_MAX_DELAY);
}

//void send_word(uint16_t data, uint8_t data_reg)
//{
//	spi_data = data >> 8;
//	if (data_reg == DATA) {
//		HAL_GPIO_WritePin(AOPin_GPIO_Port, AOPin_Pin, GPIO_PIN_SET);
//	} else{
//		HAL_GPIO_WritePin(AOPin_GPIO_Port, AOPin_Pin, GPIO_PIN_RESET);
//	}
//	HAL_SPI_Transmit(HSPI, (uint8_t *)&spi_data, (uint16_t)1, HAL_MAX_DELAY);
//	spi_data = data;
//	HAL_SPI_Transmit(HSPI, (uint8_t *)&spi_data, (uint16_t)1, HAL_MAX_DELAY);
//}

void send_word(uint16_t data, uint8_t data_reg)
{
	spi_data = data >> 8;
	if (data_reg == DATA) {
		AOPin_GPIO_Port->BSRR = AOPin_Pin;
	} else{
		AOPin_GPIO_Port->BRR = AOPin_Pin;
	}
//	HAL_SPI_Transmit(HSPI, (uint8_t *)&data, (uint16_t)2, HAL_MAX_DELAY);
	HAL_SPI_Transmit_DMA(HSPI, (uint8_t *)&data, (uint16_t)2);
}

/** 字库
字库码的引索
--------------------------------------------------------------
(0)  !(1)  "(2)  #(3)  $(4)  %(5)  &(6)  '(7)
((8)  )(9)  *(10) +(11) ,(12) -(13) .(14) /(15)
0(16) 1(17) 2(18) 3(19) 4(20) 5(21) 6(22) 7(23)
8(24) 9(25) :(26) ;(27) <(28) =(29) >(30) ?(31)
@(32) A(33) B(34) C(35) D(36) E(37) F(38) G(39)
H(40) I(41) J(42) K(43) L(44) M(45) N(46) O(47)
P(48) Q(49) R(50) S(51) T(52) U(53) V(54) W(55)
X(56) Y(57) Z(58) [(59) \(60) ](61) ^(62) _(63)
`(64) a(65) b(66) c(67) d(68) e(69) f(70) g(71)
h(72) i(73) j(74) k(75) l(76) m(77) n(78) o(79)
p(80) q(81) r(82) s(83) t(84) u(85) v(86) w(87)
x(88) y(89) z(90) {(91) |(92) }(93) ~(94)
--------------------------------------------------------------
字体:	  GulimChe12 8*16字体
取码规则:	低位在前, 列行扫描, 阴码(1-亮, 0-灭)
查表方法: 要显示的ASCII码-32就可以得到字库码的指针 */
const unsigned short Font_code16[][16] = {
  {0x00,0x00,0x00,0x00,0x00,0x00,0x00,0x00,0x00,0x00,0x00,0x00,0x00,0x00,0x00,0x00},// (0)
  {0x00,0x00,0x10,0x10,0x10,0x10,0x10,0x10,0x10,0x10,0x00,0x00,0x10,0x10,0x00,0x00},//!(1)
  {0x00,0x00,0x24,0x24,0x24,0x24,0x00,0x00,0x00,0x00,0x00,0x00,0x00,0x00,0x00,0x00},//"(3)
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  {0x00,0x00,0x00,0x00,0x00,0x00,0x8C,0x72,0x00,0x00,0x00,0x00,0x00,0x00,0x00,0x00},
};	

/*!
* @brief    液晶字符输出(8*16字体)
*
* @param    x: 0 -15   (行)
* @param    y: 0 -9  	 (列)
* @param    word_color: 字体颜色
* @param    back_color: 背景颜色
*
* @return   无
*
* @note     内部调用
*
* @see
*
* @date     2019/6/13 星期四
*/
void ili9163_P8X16(unsigned short x, unsigned short y, unsigned short c_dat,unsigned short word_color,unsigned short back_color)
{
  unsigned short i,j;
  
  SetAddata_regessWindow(x*8,y*16,(x+1)*8-1,(y+1)*16-1);			//定位字符显示区域
  
  for(j=0; j <16; j++)
  {
    for(i=0; i<8; i++)
    {
      if((Font_code16[c_dat-32][j]) & (0x01<<i))
        send_word(word_color, DATA);
      else
        send_word(back_color, DATA);
    }
  }
}
/*!
* @brief    液晶字符串输出(8*16字体)
*
* @param    x: x: 0 -15   (行)
* @param    y: y: 0 -9  	 (列)
* @param    word_color: 字体颜色
* @param    back_color: 背景颜色
*
* @return   无
*
* @note     无
*
* @see      TFTSPI_P8X16Str(1, 1, "123456", u16YELLOW, u16RED);
*
* @date     2019/6/13 星期四
*/
void ili9163_P8X16Str(unsigned short x, unsigned short y, char *s_dat,unsigned short word_color,unsigned short back_color)
{
  while(*s_dat) ili9163_P8X16(x++, y, *s_dat++,word_color,back_color);
}
